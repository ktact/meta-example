## conf/layer.conf
```bitbake
# We have a conf and classes directory, add to BBPATH
BBPATH .= ":${LAYERDIR}"

# We have recipes-* directories, add to BBFILES
BBFILES += "${LAYERDIR}/recipes-*/*/*.bb"

# Layer name
# see https://docs.yoctoproject.org/3.1.3/ref-manual/ref-manual.html#var-BBFILE_COLLECTIONS
BBFILE_COLLECTIONS += "hello"

BBFILE_PATTERN_hello = "^${LAYERDIR}/"
BBFILE_PRIORITY_hello = "70"
```
